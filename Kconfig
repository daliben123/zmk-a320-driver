## Kconfig
```kconfig
menuconfig ZMK_DRIVER_TOUCHPAD
    bool "ZMK Touchpad Driver"
    default y
    help
      Enable support for the ZMK touchpad driver, which provides
      mouse movement and scrolling functionality via an I2C touchpad.

if ZMK_DRIVER_TOUCHPAD

config ZMK_TOUCHPAD_I2C_ADDR
    hex "Touchpad I2C Address"
    default 0x3B
    help
      I2C address of the touchpad device.

config ZMK_TOUCHPAD_POLL_INTERVAL
    int "Polling Interval (ms)"
    default 10
    range 1 100
    help
      Interval at which the touchpad is polled for motion data.
      Lower values provide more responsive input but consume more CPU.

config ZMK_TOUCHPAD_SCROLL_SPEED
    int "Scroll Speed Divider"
    default 6
    range 1 10
    help
      Speed divider for scroll mode. Lower values make scrolling faster.

config ZMK_TOUCHPAD_BOOST_FACTOR
    int "Boost Mode Multiplier"
    default 2
    range 1 5
    help
      Multiplier for cursor speed in boost mode.

config ZMK_TOUCHPAD_SLOW_FACTOR
    int "Slow Mode Divider"
    default 2
    range 1 5
    help
      Divider for cursor speed in slow mode.

config ZMK_TOUCHPAD_INITIAL_MODE
    int "Initial Operation Mode"
    default 0
    range 0 3
    help
      Default operation mode when the driver starts:
      0: Normal mode (default)
      1: Scroll mode
      2: Boost mode
      3: Slow mode

config ZMK_TOUCHPAD_LOG_LEVEL
    int "Logging Level"
    default 2
    range 0 4
    help
      Set the logging verbosity for the touchpad driver:
      0: No logging
      1: Error messages
      2: Warnings
      3: Information
      4: Debug messages

endif # ZMK_DRIVER_TOUCHPAD
```

## dts/bindings/avago,a320.yaml
```yaml
description: Avago A320 TouchPad Driver

compatible: "avago,a320"

include: i2c-device.yaml

properties:
    reset-gpios:
      type: phandle-array
      required: false
      description: |
        reset pin

    motion-gpios:
      type: phandle-array
      required: false
      description: |
        motion pin

    orient-gpios:
      type: phandle-array
      required: false
      description: |
        orient pin

    shutdown-gpios:
      type: phandle-array
      required: false
      description: |
        shutdown pin
```

## dts/bindings/avago-a320.yaml
```yaml
description: Avago A320 Optical Motion Sensor Driver

compatible: "avago,a320"

include: i2c-device.yaml

properties:
    reset-gpios:
      type: phandle-array
      required: false
      description: |
        Reset pin for the A320 sensor. Active low.
        Used to reset the device to its default state.

    motion-gpios:
      type: phandle-array
      required: false
      description: |
        Motion detection output pin. Goes high when motion is detected.
        Can be used as an interrupt to wake up the system when movement occurs.

    orientation-gpios:
      type: phandle-array
      required: false
      description: |
        Orientation control pin. Configures the sensor's orientation
        (e.g., normal or inverted).

    shutdown-gpios:
      type: phandle-array
      required: false
      description: |
        Shutdown control pin. Active low.
        When pulled low, puts the sensor into a low-power state.

# Example usage in a device tree:
# a320@39 {
#     compatible = "avago,a320";
#     reg = <0x39>;
#     reset-gpios = <&gpio0 12 GPIO_ACTIVE_LOW>;
#     motion-gpios = <&gpio0 13 GPIO_ACTIVE_HIGH>;
#     shutdown-gpios = <&gpio0 14 GPIO_ACTIVE_LOW>;
# };    
```

## dts/bindings/touchpad.yaml
```yaml
description: Trackpad sensor driver binding

compatible: "trackpad,generic"

include: [i2c-device.yaml, base.yaml]

properties:
  shutdown-gpios:
    type: phandle-array
    required: true
    description: Shutdown pin

  motion-gpios:
    type: phandle-array
    required: true
    description: Motion detection pin

  reset-gpios:
    type: phandle-array
    required: true
    description: Reset pin

  blk-kbd-gpios:
    type: phandle-array
    required: false
    description: Keyboard block pin

  blk-tp-gpios:
    type: phandle-array
    required: false
    description: Trackpad block pin    
```
